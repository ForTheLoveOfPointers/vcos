## buildroot/br2-external/Config.in
```kconfig
source "$BR2_EXTERNAL_VCOS_PATH/package/vcos-runtime/Config.in"
source "$BR2_EXTERNAL_VCOS_PATH/package/vcos-guest/Config.in"
source "$BR2_EXTERNAL_VCOS_PATH/package/vcos-modules/Config.in"
source "$BR2_EXTERNAL_VCOS_PATH/package/vcos-module-host/Config.in"
source "$BR2_EXTERNAL_VCOS_PATH/package/vcos-modman/Config.in"
```

## buildroot/br2-external/configs/vcos_qemu_x86_64_defconfig
```kconfig
BR2_x86_64=y
BR2_TOOLCHAIN_BUILDROOT_MUSL=y

BR2_TARGET_GENERIC_HOSTNAME="vcos"
BR2_TARGET_GENERIC_ISSUE="VCOS virtual console"
BR2_TARGET_GENERIC_GETTY=y
BR2_TARGET_GENERIC_GETTY_PORT="ttyS0"
BR2_TARGET_GENERIC_GETTY_BAUDRATE_115200=y

BR2_INIT_BUSYBOX=y
BR2_ROOTFS_DEVICE_CREATION_DYNAMIC_DEVTMPFS=y

BR2_ROOTFS_OVERLAY="$(BR2_EXTERNAL_VCOS_PATH)/board/qemu-x86_64/overlay"
BR2_ROOTFS_POST_BUILD_SCRIPT="$(BR2_EXTERNAL_VCOS_PATH)/board/qemu-x86_64/post-build.sh"
BR2_ROOTFS_POST_IMAGE_SCRIPT="$(BR2_EXTERNAL_VCOS_PATH)/board/qemu-x86_64/post-image.sh"

BR2_LINUX_KERNEL=y
BR2_LINUX_KERNEL_DEFCONFIG="x86_64"
BR2_LINUX_KERNEL_CONFIG_FRAGMENT_FILES="$(BR2_EXTERNAL_VCOS_PATH)/board/qemu-x86_64/linux.fragment"

BR2_PACKAGE_BUSYBOX=y
BR2_PACKAGE_BUSYBOX_CONFIG_FRAGMENT_FILES="$(BR2_EXTERNAL_VCOS_PATH)/board/qemu-x86_64/busybox.fragment"
BR2_PACKAGE_VCOS_RUNTIME=y
BR2_PACKAGE_ALSA_LIB=y
BR2_PACKAGE_LIBDRM=y
BR2_PACKAGE_VCOS_GUEST=y
BR2_PACKAGE_OPENSSL=y
BR2_PACKAGE_CA_CERTIFICATES=y
BR2_PACKAGE_LIBCURL=y
BR2_PACKAGE_LIBCURL_CURL=y
BR2_PACKAGE_LIBCURL_OPENSSL=y

BR2_TARGET_ROOTFS_EXT2=y
BR2_TARGET_ROOTFS_EXT2_LABEL="VCOSROOT"
BR2_TARGET_ROOTFS_EXT2_SIZE="512M"
BR2_REPRODUCIBLE=y

BR2_TARGET_GRUB2=y
BR2_TARGET_GRUB2_X86_64_EFI=y

BR2_PACKAGE_HOST_GENIMAGE=y
BR2_PACKAGE_VCOS_MODULES=y
BR2_PACKAGE_VCOS_MODULE_HOST=y
BR2_PACKAGE_VCOS_MODMAN=y
```

## buildroot/br2-external/package/vcos-guest/Config.in
```kconfig
config BR2_PACKAGE_VCOS_GUEST
	bool "vcos-guest"
	select BR2_PACKAGE_HOST_PYTHON3
	help
	  Build the VCOS guest cartridges (shell and demo) with the
	  bundled 6502 assembler. Installed under /usr/share/vcos.
```

## buildroot/br2-external/package/vcos-modman/Config.in
```kconfig
config BR2_PACKAGE_VCOS_MODMAN
	bool "vcos-modman"
	help
	  Offline .vmod package installer for VCOS modules.
```

## buildroot/br2-external/package/vcos-module-host/Config.in
```kconfig
config BR2_PACKAGE_VCOS_MODULE_HOST
	bool "vcos-module-host"
	select BR2_PACKAGE_LIBDRM
	help
	  Load and run VCOS emulator modules in a separate process.
```

## buildroot/br2-external/package/vcos-modules/Config.in
```kconfig
config BR2_PACKAGE_VCOS_MODULES
	bool "vcos-modules"
	help
	  Emulator modules for the VCOS module host. Installs the NES and
	  null test modules under /usr/lib/vcos/modules.
```

## buildroot/br2-external/package/vcos-runtime/Config.in
```kconfig
config BR2_PACKAGE_VCOS_RUNTIME
	bool "vcos-runtime"
	help
	  VCOS virtual-console runtime: a 6502/NES-compatible virtual
	  machine that runs as the primary environment on the target.
```
